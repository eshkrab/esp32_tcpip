## Kconfig.projbuild
```kconfig
menu "TCP/IP Configuration"

choice STATIC_DHCP
    prompt "Static or DHCP"
    default CONFIG_STATIC

config DHCP
    bool "Use DHCP"
    help
      Use DHCP server on the network (requires a router).

config STATIC
    bool "Use a Static IP"
    help
      If using a static IP, specify IP address and netmask.
endchoice


menu "Static IP Config"
    depends on STATIC

config TCPIP_IP
    string "Static IP"
    default "192.168.0.10"
    help
      Static IP on the network you're connecting to

config TCPIP_NETMASK
    string "Subnet Mask"
    default "255.255.255.0"
    help
      Subnet Mask for the network

config TCPIP_GW
    string "Gateway"
    default ""
    help
      Gateway (can usually be left blank)
endmenu


choice USE_WIFI_ETH
    prompt "Use WiFi or Ethernet"
    default CONFIG_WIFI

config WIFI
    bool "WiFi"

config ETH
    bool "Ethernet"

endchoice

menu "WiFi Config"
  depends on WIFI

config WIFI_SSID
    string "WiFi SSID"
    default "mySSID"
    help
      SSID (network name) for the example to connect to.

config WIFI_PASSWORD
    string "WiFi PSWD"
    default "1234567890"
    help
      WiFi password (WPA or WPA2) for the example to use.

endmenu


config AP
    bool "WiFi Access Point"

menu "Access Point Config"
  depends on AP

choice
  prompt "Authentication mode"
  default WIFI_AUTH_WPA2_PSK
  help
    Authentication mode for the Wifi network
  config WIFI_AUTH_OPEN
    bool "Open"
  config WIFI_AUTH_WEP
    bool "WEP"
  config WIFI_AUTH_WPA_PSK
    bool "WPA-PSK"
  config WIFI_AUTH_WPA2_PSK
    bool "WPA2-PSK"
  config WIFI_AUTH_WPA_WPA2_PSK
    bool "WPA-PSK or WPA2-PSK"
  config WIFI_AUTH_WPA2_ENTERPRISE
    bool "WPA2 Enterprise"			
endchoice

config AP_SSID
    string "Access Point SSID"
    default "esp32-SSID"
    help
      SSID (network name) for the example to connect to.

config AP_PASSWORD
    string "Access Point PSWD"
    default "1234567890"
    help
      WiFi password (WPA or WPA2) for the example to use.

menu "AP IP Config"
    depends on STATIC

config AP_IP
    string "Static IP"
    default "192.168.1.1"
    help
      Static IP on the network you're connecting to

config AP_GW
    string "Gateway"
    default "192.168.1.1"
    help
      Gateway (can usually be left blank)

config AP_NETMASK
    string "Subnet Mask"
    default "255.255.255.0"
    help
      Subnet Mask for the network

endmenu

config AP_CHANNEL
  int "Wifi channel"
  default 0
  help
    Channel for the Wifi network


config AP_HIDE_SSID
  bool "Hide SSID"
  default 0
  help
    Hide SSID

config AP_MAX_CONNECTIONS
  int "Maximum concurrent connections"
  range 1 4
  default 4
  help
    Maximum number of concurrent connections (1-4)

config AP_BEACON_INTERVAL	
  int "Beacon interval (ms)"
  range 100 60000
  default 100
  help
    Beacon interval in ms (100-60000)		

endmenu


menu "PHY Config"
config PHY_ADDRESS
    int "PHY Address (0-31)"
    default 0
    range 0 31
    help
        Select the PHY Address (0-31) for the hardware configuration and PHY model.
        LAN8720 default 1 or 0


config PHY_USE_POWER_PIN
    bool "Use PHY Power (enable/disable) pin"
    default y
    help
        Use a GPIO "power pin" to power the PHY on/off during operation.
        Consult the example README for more details

config PHY_POWER_PIN
    int "PHY Power GPIO"
    default 17
    range 0 33
    depends on PHY_USE_POWER_PIN
    help
        GPIO number to use for powering on/off the PHY.

config PHY_SMI_MDC_PIN
    int "SMI MDC PIN"
    default 23
    range 0 33
    help
        GPIO number to use for MDC.

config PHY_SMI_MDIO_PIN
    int "SMI MDIO PIN"
    default 32  
    range 0 33
    help
        GPIO number to use for MDIO.
endmenu

endmenu
```
